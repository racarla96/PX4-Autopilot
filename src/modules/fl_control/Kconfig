## src/modules/fl_control/Kconfig
```kconfig
menuconfig MODULES_FL_CONTROL
	bool "fl_control"
	default n
	---help---
		Enable support for fl_control (FL trajectory-tracking flight mode)
```

## src/modules/lab_control/Kconfig
```kconfig
menuconfig MODULES_LAB_CONTROL
	bool "lab_control"
	default n
	---help---
		Enable support for lab_control (LAB trajectory-tracking flight mode)
```

## src/modules/traj_generator/Kconfig
```kconfig
menuconfig MODULES_TRAJ_GENERATOR
	bool "traj_generator"
	default n
	---help---
		Enable support for traj_generator (reference trajectory for the LAB and FL flight modes)
```
